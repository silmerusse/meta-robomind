## conf/distro/robomind.conf
```bitbake
require conf/distro/poky.conf

DISTRO = "robomind"
DISTRO_NAME = "Robomind"
DISTRO_VERSION = "1.0"
DISTRO_CODENAME = "robomind"
DISTROOVERRIDES = "poky"
MAINTAINER = "silmerusse <silmerusse@yahoo.com>"
LICENSE = "MIT"

# x11 should have been set already in poky.
# When x11 and wayland are both enabled, x11 will take priority.
DISTRO_FEATURES_append += ""

QEMU_TARGETS = "arm"

ACCEPT_FSL_EULA = "1"
LICENSE_FLAGS_WHITELIST += "commercial"

PREFERRED_PROVIDER_jpeg = "libjpeg-turbo"
PREFERRED_PROVIDER_jpeg-native = "libjpeg-turbo-native"
```
